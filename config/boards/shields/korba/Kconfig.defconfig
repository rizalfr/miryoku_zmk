## config/boards/shields/korba/Kconfig.defconfig
```kconfig
if SHIELD_KORBA_LEFT

config ZMK_KEYBOARD_NAME
    default "Korba"

endif

if SHIELD_KORBA_RIGHT

config ZMK_KEYBOARD_NAME
    default "Korba"

endif
```

## config/boards/shields/korba/Kconfig.shield
```kconfig
config SHIELD_KORBA_LEFT
    def_bool $(shields_list_contains,korba_left)

config SHIELD_KORBA_RIGHT
    def_bool $(shields_list_contains,korba_right)
```
